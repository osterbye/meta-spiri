## conf/layer.conf
```bitbake
# We have a conf and classes directory, append to BBPATH
BBPATH .= ":${LAYERDIR}"

# We have a recipes directory, add to BBFILES
BBFILES += "${LAYERDIR}/recipes*/*/*.bb ${LAYERDIR}/recipes*/*/*.bbappend"

BBFILE_COLLECTIONS += "spiri"
BBFILE_PATTERN_spiri := "^${LAYERDIR}/"
BBFILE_PRIORITY_spiri = "91"

#LICENSE_PATH += "${LAYERDIR}/licenses"
```
